## components/bsp/Kconfig
```kconfig
menu "Passport board support"
    config BSP_LVGL_DRAW_BUFFER_LINES
        int "LVGL single drawing buffer rows"
        range 1 320
        default 40
        help
            RGB565 buffer size is screen width times rows times two bytes.
            Smaller strips leave more internal DMA RAM for radio and Bluetooth,
            at the cost of additional display flush transactions.
endmenu
```

## main/Kconfig.projbuild
```kconfig
menu "Pocket Passport"
config PASSPORT_NAVIGATION_BLE
    bool "Komoot turn-by-turn BLE navigation"
    depends on BT_ENABLED && BT_NIMBLE_ENABLED && BT_NIMBLE_ROLE_CENTRAL && BT_NIMBLE_ROLE_OBSERVER
    default y
    help
        Receive route instructions from the Komoot phone app. Uses the shared
        NimBLE host when Muse is enabled. Phone compatibility needs device tests.

config PASSPORT_MUSE_BLE
    bool "Enable experimental official Muse BLE pairing"
    depends on BT_ENABLED && BT_NIMBLE_ENABLED && BT_NIMBLE_NVS_PERSIST && BT_NIMBLE_SM_SC
    default n
    help
        Start the Muse pairing/Android companion BLE services when opening Muse.
        Requires device acceptance of RAM coexistence with Wi-Fi and audio.
        Chat and voice integration are not complete yet.
config MUSE_PHONE_BRIDGE
    bool
    default y if PASSPORT_MUSE_BLE
endmenu
```
