#include "passport_app.h"
#include "passport_muse_voice.h"
#include "passport_i18n.h"
#include "bsp_audio.h"
#include "esp_http_client.h"
#include "esp_timer.h"
#include "esp_wifi.h"
#include "freertos/task.h"
#include "cJSON.h"
#include "mbedtls/base64.h"
#include <stdatomic.h>
#include <stdio.h>
#include <stdlib.h>
#include <string.h>

enum { VOICE_IDLE, VOICE_OPENING, VOICE_RECORDING, VOICE_SENDING, VOICE_WAITING, VOICE_ERROR };
static atomic_uint phase, captured, peak;
static atomic_bool pressed, cancelled;
static atomic_uint agent;
/* One audio-worker request is borrowed until acknowledged or timed out.
 * The web handler copies it under the same mutex before the worker can retire. */
static struct {unsigned serial,id;const void *body;size_t bytes;char path[160],type[32],reply[256];int status;} relay;
char *passport_voice_relay_poll(void){
 xSemaphoreTake(passport_mutex,portMAX_DELAY);
 size_t capacity=relay.id?4*((relay.bytes+2)/3)+sizeof(relay.path)+sizeof(relay.type)+96:3;
 char *body=malloc(capacity);
 if(body && relay.id){
  /* Paths/types are generated by the audio worker, never supplied by the phone.
   * Encode directly into the JSON result to avoid three simultaneous PCM copies. */
  int prefix=snprintf(body,capacity,"{\"id\":%u,\"path\":\"%s\",\"type\":\"%s\",\"body\":\"",relay.id,relay.path,relay.type);size_t used=0;
  if(prefix<0 || (size_t)prefix>=capacity-3 || mbedtls_base64_encode((unsigned char *)body+prefix,capacity-prefix-3,&used,relay.body,relay.bytes)!=0){free(body);body=NULL;}
  else memcpy(body+prefix+used,"\"}",3);
 }else if(body)memcpy(body,"{}",3);
 xSemaphoreGive(passport_mutex);return body;
}
bool passport_voice_relay_ack(unsigned id,int status,const char *body){
 if(!id || status<100 || status>599 || !body || strlen(body)>=sizeof(relay.reply))return false;
 xSemaphoreTake(passport_mutex,portMAX_DELAY);bool current=relay.id==id;
 if(current){relay.status=status;snprintf(relay.reply,sizeof(relay.reply),"%s",body);relay.id=0;relay.body=NULL;}
 xSemaphoreGive(passport_mutex);return current;
}
static int relay_post(const char *path,const void *body,size_t length,const char *type,char *reply,size_t cap){
 if(length>4096 || strlen(path)>=sizeof(relay.path) || strlen(type)>=sizeof(relay.type))return 0;
 xSemaphoreTake(passport_mutex,portMAX_DELAY);
 unsigned id=++relay.serial;if(!id)id=++relay.serial;
 relay.id=id;relay.body=body;relay.bytes=length;relay.status=0;relay.reply[0]=0;
 snprintf(relay.path,sizeof(relay.path),"%s",path);snprintf(relay.type,sizeof(relay.type),"%s",type);
 xSemaphoreGive(passport_mutex);
 int64_t deadline=esp_timer_get_time()+6000000;int status=0;
 while(passport_phone_relay_active() && esp_timer_get_time()<deadline){
  xSemaphoreTake(passport_mutex,portMAX_DELAY);
  bool done=relay.id!=id;
  if(done){status=relay.status;snprintf(reply,cap,"%s",relay.reply);}
  xSemaphoreGive(passport_mutex);
  if(done)break;
  vTaskDelay(pdMS_TO_TICKS(10));
 }
 xSemaphoreTake(passport_mutex,portMAX_DELAY);if(relay.id==id){relay.id=0;relay.body=NULL;}xSemaphoreGive(passport_mutex);return status;
}

unsigned passport_voice_phase(void){return atomic_load(&phase);}
unsigned passport_voice_bytes(void){return atomic_load(&captured);}
unsigned passport_voice_peak(void){return atomic_load(&peak);}
bool passport_voice_busy(void){unsigned p=atomic_load(&phase);return p>=VOICE_OPENING&&p<=VOICE_SENDING;}
bool passport_voice_needs_worker(void){
 return passport_voice_busy() || (agent==1 && atomic_load(&phase)==VOICE_WAITING);
}
static void message(const char *chinese,const char *english){
 if(agent==1){passport_muse_voice_message(T(chinese,english));return;}
 xSemaphoreTake(passport_mutex,portMAX_DELAY);
 char *reply=passport_reply_buffer(agent);
 if(reply){snprintf(reply,PASSPORT_REPLY_CAPACITY,"%s",T(chinese,english));passport_dirty=true;}
 xSemaphoreGive(passport_mutex);
}
void passport_voice_press(unsigned selected){
 if(selected>1||passport_voice_busy())return;
 if(selected && passport_muse_voice_active())return;
 if(selected && !passport_muse_voice_prepare()){agent=selected;atomic_store(&phase,VOICE_ERROR);return;}
 xSemaphoreTake(passport_mutex,portMAX_DELAY);bool available=selected || passport_reply_buffer(selected)!=NULL;xSemaphoreGive(passport_mutex);
 if(!selected && !available){atomic_store(&phase,VOICE_ERROR);return;}
 passport_reply_audio_stop();
 agent=selected;atomic_store(&captured,0);atomic_store(&peak,0);atomic_store(&cancelled,false);
 atomic_store(&pressed,true);atomic_store(&phase,VOICE_OPENING);
 message("正在连接麦克风\n请稍候再说话","Preparing microphone\nWait before speaking");
}
void passport_voice_release(void){atomic_store(&pressed,false);}
void passport_voice_cancel(void){atomic_store(&cancelled,true);atomic_store(&pressed,false);}

/* Audio worker owns all codec operations. Small bounded HTTP responses avoid
 * reserving the general bridge request's 10 KB response buffer while recording. */
static int post(const char *path,const void *body,size_t length,const char *type,char *reply,size_t cap){
 if(passport_phone_relay_active())return relay_post(path,body,length,type,reply,cap);
 char url[320],token[110];
 if(!passport_bridge_snapshot(path,url,sizeof(url),token,sizeof(token)))return 0;
 esp_http_client_config_t cfg={.url=url,.timeout_ms=1500,.buffer_size=512,.keep_alive_enable=false};
 esp_http_client_handle_t h=esp_http_client_init(&cfg);if(!h)return 0;
 esp_http_client_set_method(h,HTTP_METHOD_POST);esp_http_client_set_header(h,"Authorization",token);
 esp_http_client_set_header(h,"Content-Type",type);int status=0;
 if(esp_http_client_open(h,length)==ESP_OK){
  size_t sent=0;int n;
  while(sent<length&&(n=esp_http_client_write(h,(const char *)body+sent,length-sent))>0)sent+=n;
  if(sent==length&&esp_http_client_fetch_headers(h)>=0){
   status=esp_http_client_get_status_code(h);size_t used=0;
   while(used+1<cap&&(n=esp_http_client_read(h,reply+used,cap-used-1))>0)used+=n;
   reply[used]=0;if(!esp_http_client_is_complete_data_received(h))status=0;
  }
 }
 esp_http_client_close(h);esp_http_client_cleanup(h);return status;
}

static void muse_record(void *pcm,size_t capacity){
 bool audio=false,sent=false;
 if(!atomic_load(&pressed)||atomic_load(&cancelled))goto finished;
 int64_t deadline=esp_timer_get_time()+10000000;
 while(!passport_network_idle()&&atomic_load(&pressed)&&!atomic_load(&cancelled)&&esp_timer_get_time()<deadline)vTaskDelay(pdMS_TO_TICKS(50));
 if(!atomic_load(&pressed)||atomic_load(&cancelled))goto finished;
 if(!passport_network_idle()){message("网络正忙\n请稍后重试","Network busy\nPlease retry");goto error;}
 if(!passport_muse_voice_begin())goto error;
 if(!atomic_load(&pressed)||atomic_load(&cancelled))goto finished;
 audio=bsp_audio_init()==ESP_OK;
 if(!audio||bsp_audio_set_format(16000,16,1)!=ESP_OK){message("麦克风初始化失败\n请稍后重试","Microphone unavailable\nPlease retry");goto error;}
 atomic_store(&phase,VOICE_RECORDING);message("正在录音\n松开下键发送","Recording\nRelease Down to send");
 int64_t began=esp_timer_get_time(),updated=began;
 while(atomic_load(&pressed)&&!atomic_load(&cancelled)&&esp_timer_get_time()-began<30000000){
  unsigned bytes=atomic_load(&captured);if(bytes>=960000)break;
  size_t n=capacity&~(size_t)3;if(n>960000-bytes)n=(960000-bytes)&~(size_t)3;
  if(!n||bsp_audio_read(pcm,n)!=ESP_OK){message("录音失败\n请重试","Recording failed\nPlease retry");goto error;}
  unsigned level=0;int16_t *samples=pcm;
  for(size_t i=0;i<n/2;i++){int value=samples[i];unsigned magnitude=value<0?-value:value;if(magnitude>level)level=magnitude;}
  atomic_store(&peak,level);
  if(!passport_muse_voice_audio(samples,n/2)){message("Muse 语音传输失败\n请重试","Muse audio transfer failed\nPlease retry");goto error;}
  atomic_fetch_add(&captured,n);
  if(esp_timer_get_time()-updated>=500000){
   char progress[96];snprintf(progress,sizeof(progress),T("正在录音 %u 秒\n松开下键发送","Recording %u sec\nRelease Down to send"),(unsigned)((esp_timer_get_time()-began)/1000000));
   passport_muse_voice_message(progress);updated=esp_timer_get_time();
  }
 }
 if(audio){bsp_audio_deinit();audio=false;}
 if(atomic_load(&cancelled))goto finished;
 if(atomic_load(&captured)<6400){message("录音太短\n请按住下键再说话","Recording too short\nHold Down and speak");goto error;}
 atomic_store(&phase,VOICE_SENDING);
 if(!passport_muse_voice_finish())goto error;
 sent=true;atomic_store(&phase,VOICE_WAITING);goto finished;
error:
 atomic_store(&phase,VOICE_ERROR);
finished:
 if(audio)bsp_audio_deinit();
 if(!sent)passport_muse_voice_cancel();
 atomic_store(&pressed,false);
 if(atomic_load(&cancelled)||atomic_load(&phase)==VOICE_OPENING){atomic_store(&phase,VOICE_IDLE);message("录音已取消","Recording cancelled");}
}
void passport_voice_poll(void){
 unsigned state=passport_muse_voice_poll();
 if(agent==1 && atomic_load(&phase)==VOICE_WAITING){
  if(state==2 || state==0)atomic_store(&phase,VOICE_IDLE);
  else if(state==3)atomic_store(&phase,VOICE_ERROR);
 }
}

void passport_voice_run(void *pcm,size_t capacity){
 if(!passport_voice_busy())return;
 if(agent==1){muse_record(pcm,capacity);return;}
 char reply[256],session[33]={0},path[160],body[80];bool audio=false,ok=false;
 if(!atomic_load(&pressed)||atomic_load(&cancelled))goto finished;
 int64_t deadline=esp_timer_get_time()+6000000;
 while(!passport_network_idle()&&atomic_load(&pressed)&&!atomic_load(&cancelled)&&esp_timer_get_time()<deadline)vTaskDelay(pdMS_TO_TICKS(50));
 if(!atomic_load(&pressed)||atomic_load(&cancelled))goto finished;
 if(!passport_network_idle()){message("网络正忙\n请稍后重试","Network busy\nPlease retry");goto error;}
 const char *start="{\"agent\":\"hermes\",\"sample_rate\":16000,\"channels\":1,\"format\":\"s16le\"}";
 int status=post("/v1/voice/start",start,strlen(start),"application/json",reply,sizeof(reply));
 cJSON *j=status==200?cJSON_Parse(reply):NULL,*id=cJSON_GetObjectItem(j,"session");
 if(cJSON_IsString(id)&&strlen(id->valuestring)==32){
  bool valid=true;for(unsigned i=0;i<32;i++)if(!((id->valuestring[i]>='0'&&id->valuestring[i]<='9')||(id->valuestring[i]>='a'&&id->valuestring[i]<='f')))valid=false;
  if(valid)snprintf(session,sizeof(session),"%s",id->valuestring);
 }
 cJSON_Delete(j);
 if(!session[0]){message("语音服务未就绪\n请检查电脑桥接","Voice service unavailable\nCheck the computer bridge");goto error;}
 if(!atomic_load(&pressed)||atomic_load(&cancelled))goto finished;
 audio=bsp_audio_init()==ESP_OK;
 if(!audio||bsp_audio_set_format(16000,16,1)!=ESP_OK){message("麦克风初始化失败\n请稍后重试","Microphone unavailable\nPlease retry");goto error;}
 (void)esp_wifi_set_ps(WIFI_PS_NONE);atomic_store(&phase,VOICE_RECORDING);
 message("正在录音\n松开下键发送","Recording\nRelease Down to send");
 int64_t began=esp_timer_get_time(),updated=began;unsigned sequence=0;
 while(atomic_load(&pressed)&&!atomic_load(&cancelled)&&esp_timer_get_time()-began<30000000){
  unsigned bytes=atomic_load(&captured);if(bytes>=960000)break;
  size_t n=capacity;if(n>960000-bytes)n=960000-bytes;
  if(bsp_audio_read(pcm,n)!=ESP_OK){message("录音失败\n请重试","Recording failed\nPlease retry");goto error;}
  unsigned level=0;int16_t *samples=pcm;
  for(size_t i=0;i<n/2;i++){int value=samples[i];unsigned magnitude=value<0?-value:value;if(magnitude>level)level=magnitude;}
  atomic_store(&peak,level);
  snprintf(path,sizeof(path),"/v1/voice/chunk?session=%s&seq=%u",session,sequence);
  status=post(path,pcm,n,"application/octet-stream",reply,sizeof(reply));
  if(status!=200){message("语音上传失败\n未发送，请重试","Voice upload failed\nNot sent; please retry");goto error;}
  sequence++;atomic_fetch_add(&captured,n);
  if(esp_timer_get_time()-updated>=500000){
   xSemaphoreTake(passport_mutex,portMAX_DELAY);
   char *progress=passport_reply_buffer(agent);
   if(progress){snprintf(progress,PASSPORT_REPLY_CAPACITY,T("正在录音 %u 秒\n松开下键发送","Recording %u sec\nRelease Down to send"),(unsigned)((esp_timer_get_time()-began)/1000000));passport_dirty=true;}
   xSemaphoreGive(passport_mutex);updated=esp_timer_get_time();
  }
 }
 if(audio){bsp_audio_deinit();audio=false;}(void)esp_wifi_set_ps(WIFI_PS_MIN_MODEM);
 if(atomic_load(&cancelled))goto finished;
 if(atomic_load(&captured)<6400){message("录音太短\n请按住下键再说话","Recording too short\nHold Down and speak");goto error;}
 atomic_store(&phase,VOICE_SENDING);message("正在识别语音\n等待 Hermes 回复","Recognising speech\nWaiting for Hermes");
 snprintf(body,sizeof(body),"{\"session\":\"%s\"}",session);
 status=post("/v1/voice/finish",body,strlen(body),"application/json",reply,sizeof(reply));
 if(status!=202){message("语音提交失败\n请重试","Voice submission failed\nPlease retry");goto error;}
 ok=true;atomic_store(&phase,VOICE_WAITING);goto finished;
error:
 atomic_store(&phase,VOICE_ERROR);
finished:
 if(audio)bsp_audio_deinit();
 (void)esp_wifi_set_ps(WIFI_PS_MIN_MODEM);
 if(session[0]&&!ok){snprintf(body,sizeof(body),"{\"session\":\"%s\"}",session);post("/v1/voice/cancel",body,strlen(body),"application/json",reply,sizeof(reply));}
 atomic_store(&pressed,false);
 if(atomic_load(&cancelled)||atomic_load(&phase)==VOICE_OPENING){atomic_store(&phase,VOICE_IDLE);message("录音已取消","Recording cancelled");}
}
